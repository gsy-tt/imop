/dts-v1/;
#include <dt-bindings/clock/qcom,ipq5332-gcc.h>
#include <dt-bindings/interrupt-controller/arm-gic.h>

/ {
	model = "IPQ5332 USB Test";
	compatible = "qcom,ipq5332";
	#address-cells = <2>;
	#size-cells = <2>;

	interrupt-parent = <&intc>;

	/* USB 3.0 controller */
	usb3: usb@8af8800 {
		compatible = "qcom,dwc3";
		reg = <0x0 0x08af8800 0x0 0x400>;
		interrupts = <0 37 0>;
		clocks = <&gcc GCC_USB30_MASTER_CLK>;
		clock-names = "core";
		status = "okay";
	};
};