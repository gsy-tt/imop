# 0 "/home/teng/imop/correct_usb_test.dts"
# 0 "<built-in>"
# 0 "<command-line>"
# 1 "/usr/include/stdc-predef.h" 1 3 4
# 0 "<command-line>" 2
# 1 "/home/teng/imop/correct_usb_test.dts"
/dts-v1/;
# 1 "./include/dt-bindings/clock/qcom,ipq5332-gcc.h" 1
# 3 "/home/teng/imop/correct_usb_test.dts" 2
# 1 "./include/dt-bindings/interrupt-controller/arm-gic.h" 1
# 9 "./include/dt-bindings/interrupt-controller/arm-gic.h"
# 1 "./include/dt-bindings/interrupt-controller/irq.h" 1
# 10 "./include/dt-bindings/interrupt-controller/arm-gic.h" 2
# 4 "/home/teng/imop/correct_usb_test.dts" 2

/ {
 model = "IPQ5332 USB Test";
 compatible = "qcom,ipq5332";
 #address-cells = <2>;
 #size-cells = <2>;


 usb3: usb@8af8800 {
  compatible = "qcom,dwc3";
  reg = <0x0 0x08af8800 0x0 0x400>;
  #address-cells = <2>;
  #size-cells = <2>;
  ranges;

  interrupts = <0 37 0>;

  clocks = <&gcc GCC_USB30_MASTER_CLK>;
  clock-names = "core";

  status = "okay";

  dwc_0: usb@8a00000 {
   compatible = "snps,dwc3";
   reg = <0x0 0x08a00000 0x0 0xcd00>;
   interrupts = <0 37 0>;
   dr_mode = "host";
   status = "okay";
  };
 };
};
