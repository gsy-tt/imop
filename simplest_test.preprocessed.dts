# 0 "/home/teng/imop/simplest_test.dts"
# 0 "<built-in>"
# 0 "<command-line>"
# 1 "/usr/include/stdc-predef.h" 1 3 4
# 0 "<command-line>" 2
# 1 "/home/teng/imop/simplest_test.dts"
/dts-v1/;

/ {
 model = "Test";
 compatible = "test";
};


&usb3 {
 compatible = "qcom,dwc3";
 reg = <0x08800000 0x10000>;
 interrupts = <0 37 0>;
 status = "okay";
};
