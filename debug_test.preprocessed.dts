# 0 "/home/teng/imop/debug_test.dts"
# 0 "<built-in>"
# 0 "<command-line>"
# 1 "/usr/include/stdc-predef.h" 1 3 4
# 0 "<command-line>" 2
# 1 "/home/teng/imop/debug_test.dts"
/dts-v1/;

/ {
 model = "Test";
 compatible = "test";


 vreg_usb3: regulator-usb3 {
  compatible = "qcom,pm8005-regulator";
  regulator-name = "vdd-usb3-3.3v";
  regulator-min-microvolt = <3300000>;
  regulator-max-microvolt = <3300000>;
  regulator-boot-on;
 };
};


&usb3 {
 compatible = "qcom,dwc3";
 reg = <0x08800000 0x10000>;
 interrupts = <0 37 0>;
 clocks = <&gcc GCC_USB30_MASTER_CLK>;
 clock-names = "core";
 dr_mode = "host";
 vbus-supply = <&vreg_usb3>;
 status = "okay";
};
