/dts-v1/;
#include <dt-bindings/gpio/gpio.h>
#include <dt-bindings/input/input.h>
#include <dt-bindings/interrupt-controller/irq.h>
#include <dt-bindings/clock/qcom,ipq5332-gcc.h>

/ {
	test {
		compatible = "test";
		interrupts = <GIC_SPI 37 0>;
	};
};